#include "oled.h"

uint8_t line, column, scroll;

// Standard ASCII 5x8 font (chars 32 - 127):
// Font: 5x8 pixels:
// The index 11 has this values: 0x08, 0x08, 0x3E, 0x08, 0x08
// Represent char +
//
// 0x08 => 00001000
// 0x08 => 00001000
// 0x3E => 00111110
// 0x08 => 00001000
// 0x08 => 00001000
//
__code uint8_t OLED_FONT[][5] = {
  {0x00, 0x00, 0x00, 0x00, 0x00}, //  0 => sp
  {0x00, 0x00, 0x2f, 0x00, 0x00}, //  1 => !
  {0x00, 0x07, 0x00, 0x07, 0x00}, //  2 => "
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  {0x00, 0x82, 0x7C, 0x10, 0x00}, // 94 => }
};

// Set cursor to line start
void oled_set_line(uint8_t line) {
  I2C_start(OLED_ADDR);        // start transmission to OLED
  I2C_write(OLED_COMMAND);     // set command mode
  I2C_write(OLED_PAGE + line); // set line
  I2C_write(0x00);
  I2C_write(0x10);             // set column to "0"
  I2C_stop();                  // stop transmission
}

// Clear line
void oled_clear_line(uint8_t line) {
  oled_set_line(line);                        // set cursor to line start
  I2C_start(OLED_ADDR);                       // start transmission to OLED
  I2C_write(OLED_DAT_MODE);                   // set data mode
  for(uint8_t i=128; i; i--) I2C_write(0x00); // clear the line
  I2C_stop();                                 // stop transmission
}

// Clear screen
void oled_clear(void) {
  for(uint8_t i=0; i<8; i++) oled_clear_line(i);
  line = scroll = 0;
  column = 0;
  oled_set_line((line + scroll) & 0x07);
}

// OLED clear the top line, then scroll the display up by one line
void oled_scroll_display(void) {
  oled_clear_line(scroll);      // clear line
  scroll = (scroll + 1) & 0x07; // set next line
  I2C_start(OLED_ADDR);         // start transmission to OLED
  I2C_write(OLED_COMMAND);      // set command mode
  I2C_write(OLED_OFFSET);       // set display offset:
  I2C_write(scroll << 3);       // scroll up
  I2C_stop();                   // stop transmission
}

// Send command on I2C.
void oled_send_command(uint8_t cmd){
    I2C_start(OLED_ADDR);
    I2C_write(OLED_COMMAND);
    I2C_write(cmd);
    I2C_stop();
}

// Init function
void oled_init(void) {
  I2C_init();
  oled_send_command(OLED_MULTIPLEX);   // Set multiplex ratio
  oled_send_command(0x3F);
  oled_send_command(OLED_CHARGEPUMP);
  oled_send_command(0x14);
  oled_send_command(OLED_MEMORYMODE);  // Set page addressing mode
  oled_send_command(0x02);
  oled_send_command(OLED_COMPINS);     // set com pins
  oled_send_command(0x12);
  oled_send_command(OLED_CONTRAST);    // Set contrast.
  oled_send_command(0b00001111);
  oled_send_command(OLED_XFLIP);       // flip screen
  oled_send_command(OLED_YFLIP);
  oled_send_command(OLED_DISPLAY_ON);  // display on
  oled_clear();
}

// Plot a single character
void oled_plot_char(char c) {
  uint16_t ptr = c - 32;                  // character pointer
  I2C_start(OLED_ADDR);                   // start transmission to OLED
  I2C_write(OLED_DAT_MODE);               // set data mode
  for(uint8_t i=0; i < sizeof(OLED_FONT[ptr]); i++) {
    I2C_write(OLED_FONT[ptr][i]);
  }
  I2C_write(0x00);                        // write space between characters
  I2C_stop();                             // stop transmission
}

// OLED write a character or handle control characters
void oled_write(char c) {
  c = c & 0x7F; // ignore top bit
  // normal character
  if(c >= 32) {
    oled_plot_char(c);
    if(++column > 20) {
      column = 0;
      if(line == 7) oled_scroll_display();
      else line++;
      oled_set_line((line + scroll) & 0x07);
    }
  }
  // new line
  else if(c == '\n') {
    column = 0;
    if(line == 7) oled_scroll_display();
    else line++;
    oled_set_line((line + scroll) & 0x07);
  }
  // carriage return
  else if(c == '\r') {
    column = 0;
    oled_set_line((line + scroll) & 0x07);
  }
}

// Print string
void oled_print(char* str) {
  while(*str) oled_write(*str++);
}

void oled_set_position(uint8_t l, uint8_t c) {
  line = scroll = 0;
  column = 0;
  oled_set_line(1);
}
